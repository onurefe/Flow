/* -*- C -*- */

#include "demodulation.h"

int16_t SineTable[] = {
0x0, 		0x81, 		0x102, 		0x183, 		0x203, 		0x284, 		0x304, 		0x385, 		0x406, 	
0x486, 		0x507, 		0x587, 		0x608, 		0x689, 		0x709, 		0x78a, 		0x80a, 	
0x88a, 		0x90b, 		0x98b, 		0xa0b, 		0xa8c, 		0xb0c, 		0xb8c, 		0xc0c, 	
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0x7ff3, 	0x7ff6, 	0x7ff9, 	0x7ffb, 	0x7ffd, 	0x7ffe, 	0x7fff};

void getHalfHarmonics(uint16_t *adcBuffer, Bool_t secondHalf, float *m0Real, float *m0Img, float *m1Real, float *m1Img)
{
   	qint0_31_t qm0_real = 0;
    qint0_31_t qm0_img = 0;
    qint0_31_t qm1_real = 0;
    qint0_31_t qm1_img = 0;
    
  	uint16_t quadoffset = SAMPLES_PER_MEASUREMENT >> 2;
    qint0_15_t sine, cosine;
    uint16_t sidx = DEAD_SAMPLES;
    uint16_t *adcbuff = adcBuffer[secondHalf * SAMPLES_PER_MEASUREMENT];
    
    if (!secondHalf)
    {
    	while (sidx < quadoffset)
    	{
    		sine = SineTable[sidx];
    		cosine = SineTable[quadoffset - (sidx + 1)];
    	
    		qm0_real += adcbuff[sidx];
			qm0_real += adcbuff[sidx + quadoffset];
		
			qm1_real += (adcbuff[sidx] * cosine) >> 6;
	    	qm1_img -= (adcbuff[sidx] * sine) >> 6;
	    
	   		qm1_real -= (adcbuff[sidx + quadoffset] * sine) >> 6;
	    	qm1_img -= (adcbuff[sidx + quadoffset] * cosine) >> 6;
	   	
	   		sidx++;
	    
		    qm0_img -= adcbuff[sidx];
			qm0_img -= adcbuff[sidx + quadoffset];
			 
			qm1_real -= (adcbuff[sidx] * sine) >> 6;
			qm1_img -= (adcbuff[sidx] * cosine) >> 6;
		   
		    qm1_real -= (adcbuff[sidx + quadoffset] * cosine) >> 6;
		   	qm1_img += (adcbuff[sidx + quadoffset] * sine) >> 6;
		    
			sidx++;
	    
		    qm0_real -= adcbuff[sidx];
			qm0_real -= adcbuff[sidx + quadoffset];
			
			qm1_real -= (adcbuff[sidx] * cosine) >> 6;
		    qm1_img += (adcbuff[sidx] * sine) >> 6;
		    
		   	qm1_real += (adcbuff[sidx + quadoffset] * sine) >> 6;
		    qm1_img += (adcbuff[sidx + quadoffset] * cosine) >> 6;
		   	
		   	sidx++;
	    
		    qm0_img += adcbuff[sidx];
			qm0_img += adcbuff[sidx + quadoffset];
		
			qm1_real += (adcbuff[sidx] * sine) >> 6;	
			qm1_img += (adcbuff[sidx] * cosine) >> 6;
		    
		    qm1_real += (adcbuff[sidx + quadoffset] * cosine) >> 6;
		   	qm1_img -= (adcbuff[sidx + quadoffset] * sine) >> 6;
		    
		   	sidx++;
    	}
    }
    else
    {
    	while (sidx < quadoffset)
	    {
	    	sine = SineTable[sidx];
	    	cosine = SineTable[quadoffset - (sidx + 1)];
	    	
	    	qm0_real += adcbuff[sidx];
			qm0_real += adcbuff[sidx + quadoffset];
			
			qm1_real -= (adcbuff[sidx] * cosine) >> 6;
		    qm1_img += (adcbuff[sidx] * sine) >> 6;
		    
		   	qm1_real += (adcbuff[sidx + quadoffset] * sine) >> 6;
		    qm1_img += (adcbuff[sidx + quadofset] * cosine) >> 6;
		   	
		   	sidx++;
		    
		    qm0_img -= adcbuff[sidx];
			qm0_img -= adcbuff[sidx + quadoffset];
			 
			qm1_real += (adcbuff[sidx] * sine) >> 6;
			qm1_img += (adcbuff[sidx] * cosine) >> 6;
		   
		    qm1_real += (adcbuff[sidx + quadoffset] * cosine) >> 6;
		   	qm1_img -= (adcbuff[sidx + quadoffset] * sine) >> 6;
		    
		   	sidx++;
		    
		    qm0_real -= adcbuff[sidx];
			qm0_real -= adcbuff[sidx + quadoffset];
			
			qm1_real += (adcbuff[sidx] * cosine) >> 6;
		    qm1_img -= (adcbuff[sidx] * sine) >> 6;
		    
		   	qm1_real -= (adcbuff[sidx + quadoffset] * sine) >> 6;
		    qm1_img -= (adcbuff[sidx + quadoffset] * cosine) >> 6;
		   	
		   	sidx++;
		    
		    qm0_img += adcbuff[sidx];
			qm0_img += adcbuff[sidx + quadoffset];
		
			qm1_real -= (adcbuff[sidx] * sine) >> 6;	
			qm1_img -= (adcbuff[sidx] * cosine) >> 6;
		    
		    qm1_real -= (adcbuff[sidx + quadoffset] * cosine) >> 6;
		   	qm1_img += (adcbuff[sidx + quadoffset] * sine) >> 6;
		        
		    sidx++;
	    }
    }
    
    // Scale m0 components.
    qm0_real = qm0_real << 9;
    qm0_img = qm0_img << 9;
    
    // Set return value.
    *m0Real = qm0_real;
    *m0Img = qm0_img;
    *m1Real = qm1_real;
    *m1Img = qm1_img;
}